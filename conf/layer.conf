## conf/layer.conf
```bitbake
# We have a conf and classes directory, add to BBPATH
BBPATH .= ":${LAYERDIR}"

# We have recipes-* directories, add to BBFILES
BBFILES += "${LAYERDIR}/recipes-*/*/*.bb \
            ${LAYERDIR}/recipes-*/*/*.bbappend"

BBFILE_COLLECTIONS += "meta-fix"
BBFILE_PATTERN_meta-fix = "^${LAYERDIR}/"
BBFILE_PRIORITY_meta-fix = "9"

LAYERDEPENDS_meta-fix = "core"
LAYERSERIES_COMPAT_meta-fix = "nanbield"
```
